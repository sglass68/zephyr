## dts/bindings/espi/nuvoton,npcx-host-uart.yaml
```yaml
# Copyright (c) 2020 Nuvoton Technology Corporation.
# SPDX-License-Identifier: Apache-2.0

description: Nuvoton, NPCX-Host UART IO node

compatible: "nuvoton,npcx-host-uart"

include: [base.yaml]

properties:
    pinctrl:
        type: phandles
        required: true
        description: configurations of host uart pinmux controllers
```

## samples/cros_ec/sample.yaml
```yaml
sample:
  description: Chrome OS EC sample
    application
  name: cros_ec
common:
    tags: ec
    harness: console
    harness_config:
      type: one_line
      regex:
        - "Hello World! (.*)"
tests:
  sample.cros_ec:
    tags: introduction
```

## soc/arm/st_stm32/stm32f0/Kconfig.defconfig.stm32f098xx
```kconfig
# Kconfig - ST Microelectronics STM32F098XX MCU
#
# Copyright (c) 2019 The Chromium OS Authors
#
# SPDX-License-Identifier: Apache-2.0
#

if SOC_STM32F098XX

config SOC
	string
	default "stm32f098xx"

config NUM_IRQS
	int
	default 31

endif # SOC_STM32F098xx
```

## subsys/ec/Kconfig
```kconfig
# Kconfig.backends - Shell badckends configuration options

#
# Copyright 2019 Google LLC
#
# SPDX-License-Identifier: Apache-2.0
#

config CROS_EC
	bool "Support Chrome OS EC"
	default y
```

## subsys/shell/cros_ec/Kconfig
```kconfig
config CMD_TIMERINFO
	bool "timerinfo - show information about timer"
	default y

config CMD_GPIO
	bool "gpio - allow seting / getting GPIO info"
	default y
```
